/ {
  compatible = "zmk,keyboard";
  description = "Rhymestone";

  chosen {
    zmk,keyboard = &key_matrix;
  };

  key_matrix: key-matrix {
    compatible = "zmk,matrix";
    row-gpios = <&gpio0 10 (GPIO_ACTIVE_HIGH)>,
                <&gpio0 11 (GPIO_ACTIVE_HIGH)>,
                <&gpio0 12 (GPIO_ACTIVE_HIGH)>,
                <&gpio0 13 (GPIO_ACTIVE_HIGH)>;
    col-gpios = <&gpio1 0 (GPIO_ACTIVE_HIGH)>,
                <&gpio1 1 (GPIO_ACTIVE_HIGH)>,
                <&gpio1 2 (GPIO_ACTIVE_HIGH)>,
                <&gpio1 3 (GPIO_ACTIVE_HIGH)>,
                <&gpio1 4 (GPIO_ACTIVE_HIGH)>;
    diode-direction = COL2ROW;
  };
};
